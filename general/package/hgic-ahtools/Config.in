## general/package/hgic-ahtools/Config.in
```kconfig
config BR2_PACKAGE_HGIC_AHTOOLS
	bool "hgic-ahtools"
	help
	  management tools for Huge-IC 802.11ah NIC
```

## general/package/hgic-fmac-openipc/Config.in
```kconfig
config BR2_PACKAGE_HGIC_FMAC_OPENIPC
	bool "hgic-fmac-openipc"
	depends on BR2_LINUX_KERNEL
	help
	  HUGE-IC FullMAC Wireless Card Driver
	  
comment "hgic-fmac needs a Linux kernel to be built"
	depends on !BR2_LINUX_KERNEL
```

## general/package/inject-tools/Config.in
```kconfig
config BR2_PACKAGE_INJECT_TOOLS
	bool "inject-tools"
	default n
	help
	  Simple packet injection tools for testing Wi-Fi NICs
	  Github @libc0607
```

## general/package/rtl8188fu-openipc-fpv/Config.in
```kconfig
config BR2_PACKAGE_RTL8188FU_OPENIPC_FPV
	bool "rtl8188fu-openipc-fpv"
	depends on BR2_LINUX_KERNEL
	help
	  FPV driver for the RTL8188FU USB Wi-Fi adapter.

	  Make sure your target kernel has the CONFIG_WIRELESS_EXT
	  config option enabled.

	  Note: this package needs a firmware loading mechanism to
	  load the binary blob for the chip to work.


comment "rtl8188fu needs a Linux kernel to be built"
	depends on !BR2_LINUX_KERNEL
```

## general/package/rtl8192eu-openipc-fpv/Config.in
```kconfig
config BR2_PACKAGE_RTL8192EU_OPENIPC_FPV
	bool "rtl8192eu-openipc-fpv"
	depends on BR2_LINUX_KERNEL
	help
	  FPV driver for the RTL8192EU USB Wi-Fi adapter.

	  Make sure your target kernel has the CONFIG_WIRELESS_EXT
	  config option enabled.

	  Note: this package needs a firmware loading mechanism to
	  load the binary blob for the chip to work.

	  https://github.com/libc0607/rtl8192eu-20220929

comment "rtl8192eu needs a Linux kernel to be built"
	depends on !BR2_LINUX_KERNEL
```

## general/package/rtl8733bu-openipc-fpv/Config.in
```kconfig
config BR2_PACKAGE_RTL8733BU_OPENIPC_FPV
	bool "rtl8733bu-openipc-fpv"
	depends on BR2_LINUX_KERNEL
	help
	  A standalone driver for the RTL8733BU Dual Band
	  USB Wi-Fi adapter.

	  Make sure your target kernel has the CONFIG_WIRELESS_EXT
	  config option enabled.

	  Note: this package needs a firmware loading mechanism to
	  load the binary blob for the chip to work.


comment "rtl8733bu needs a Linux kernel to be built"
	depends on !BR2_LINUX_KERNEL
```

## general/package/rtl8822cs-openipc-fpv/Config.in
```kconfig
config BR2_PACKAGE_RTL8822CS_OPENIPC_FPV
	bool "rtl8822cs-openipc-fpv"
	depends on BR2_LINUX_KERNEL
	help
	  A standalone driver for the RTL8822CS Dual Band
	  SDIO Wi-Fi adapter.

	  Make sure your target kernel has the CONFIG_WIRELESS_EXT
	  config option enabled.

	  Note: this package needs a firmware loading mechanism to
	  load the binary blob for the chip to work.


comment "rtl8822cs needs a Linux kernel to be built"
	depends on !BR2_LINUX_KERNEL
```

## general/package/rtl8852bu-openipc/Config.in
```kconfig
config BR2_PACKAGE_RTL8852BU_OPENIPC
	bool "rtl8852bu-openipc"
	depends on BR2_LINUX_KERNEL
	help
	  A standalone driver for the RTL8852BU Dual Band
	  USB Wi-Fi adapter.

	  Make sure your target kernel has the CONFIG_WIRELESS_EXT
	  config option enabled.

	  Note: this package needs a firmware loading mechanism to
	  load the binary blob for the chip to work.


comment "rtl8852bu needs a Linux kernel to be built"
	depends on !BR2_LINUX_KERNEL
```

## general/package/rtl88x2cu-openipc-fpv/Config.in
```kconfig
config BR2_PACKAGE_RTL88X2CU_OPENIPC_FPV
	bool "rtl88x2cu-openipc-fpv"
	depends on BR2_LINUX_KERNEL
	help
	  FPV driver for the RTL8812CU/RTL8822CU Dual Band
	  USB Wi-Fi adapter.

	  Make sure your target kernel has the CONFIG_WIRELESS_EXT
	  config option enabled.

	  Note: this package needs a firmware loading mechanism to
	  load the binary blob for the chip to work.
	  
	  https://github.com/libc0607/rtl88x2cu-20230728


comment "rtl88x2cu needs a Linux kernel to be built"
	depends on !BR2_LINUX_KERNEL
```
